/*
 * CAUTION: This file is automatically generated by Xilinx.
 * Version:  
 * Today is: Sat Feb 27 21:06:26 2021
 */


/ {
	amba_pl: amba_pl@0 {
		#address-cells = <2>;
		#size-cells = <2>;
		compatible = "simple-bus";
		ranges ;
		CountBits_0: CountBits@400000000 {
			clock-names = "axil_aclk";
			clocks = <&zynqmp_clk 71>;
			compatible = "xlnx,CountBits-1.0";
			reg = <0x00000004 0x00000000 0x0 0x2000 0x00000020 0x00000000 0x0 0x4000>;
		};
	};
};
